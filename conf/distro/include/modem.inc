## conf/distro/include/modem.inc
```bitbake
DISTRO_FEATURES:append = " cgroup"
LAYERSERIES_COMPAT_zkres += "WTFPL Apache-2.0"
```

## conf/distro/include/versions.conf
```bitbake
S57_RELEASE ?= "0.1"
S57_BRANCH  ?= "master"
S57_GIT ?= "github.com/kuscsik/"
S57_GIT_PROTOCOL ?= "ssh"
```

## conf/layer.conf
```bitbake
BBPATH .= ":${LAYERDIR}"

BBFILES += "\
            ${LAYERDIR}/recipes-*/*/*.bb \
            ${LAYERDIR}/recipes-*/*/*.bbappend \
           "

BBFILE_COLLECTIONS += "s57"
BBFILE_PATTERN_s57:= "^${LAYERDIR}/"
BBFILE_PRIORITY_s57 = "7"

# Additional license directories.
LICENSE_PATH += "${LAYERDIR}/licenses"
```

## recipes-core/wic/bootimg_demo.wks
```
part /boot --source bootimg-partition --ondisk mmcblk0 --fstype=vfat --label boot --active --align 4096 --size 20M
part / --source rootfs --ondisk mmcblk0 --fstype=ext4 --label root --align 4096 --size 200M
part swap --ondisk mmcblk0 --size 128 --fstype=swap --label swap
bootloader --ptable gpt
```
